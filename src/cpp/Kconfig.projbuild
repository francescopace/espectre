## src/cpp/Kconfig.projbuild
```kconfig
rsource "runtime/esp_idf/espectre_config/Kconfig.projbuild"

menu "ESPectre SDK"

comment "Optional runtime capabilities. The sensing runtime is always built."

config ESPECTRE_SDK_ENABLE_FRONTEND_SUPPORT
    bool "Build the frontend support helpers"
    select ESPECTRE_SDK_ENABLE_PROVISIONING
    default n
    help
        Shared bootstrap, control, sysinfo, and MQTT payload helpers used by
        the reference frontends. Enable it if your integration reuses them
        instead of wiring the runtime contracts yourself. Also enables the
        provisioning service required by the shared Wi-Fi bootstrap helpers.

config ESPECTRE_SDK_ENABLE_MQTT
    bool "Build the ESP-IDF MQTT transport"
    default n
    help
        Adds EspIdfMqttTransport, the shipped IMqttTransport implementation
        over esp-mqtt. Leave it off if you implement IMqttTransport against
        your own client.

config ESPECTRE_SDK_ENABLE_PROVISIONING
    bool "Build the Wi-Fi provisioning service"
    default n
    help
        Adds the NVS-backed device config store and the Wi-Fi provisioning
        service used to apply credentials supplied by the integrating firmware
        or Direct HTTP. Improv Serial is owned by the firmware.

config ESPECTRE_SDK_ENABLE_DIRECT
    bool "Build the Direct HTTP control plane"
    default n
    help
        Adds the local Direct HTTP transport, the shared runtime bridge,
        and the canonical _espectre._tcp discovery service.

endmenu
```

## src/cpp/examples/wifi_motion_detection/main/Kconfig.projbuild
```kconfig
menu "ESPectre example"

config ESPECTRE_EXAMPLE_WIFI_SSID
    string "Wi-Fi SSID"
    default ""

config ESPECTRE_EXAMPLE_WIFI_PASSWORD
    string "Wi-Fi password"
    default ""
    help
        Leave empty for an open network. Credentials stay in the local sdkconfig.

config ESPECTRE_EXAMPLE_WIFI_BSSID
    string "Wi-Fi BSSID (optional)"
    default ""
    help
        Pin the station to one access point, using XX:XX:XX:XX:XX:XX format.
        Leave empty to let the station select an access point.

endmenu
```

## src/cpp/examples/wifi_motion_detection/sdkconfig.defaults
```kconfig
CONFIG_ESP_WIFI_CSI_ENABLED=y
CONFIG_ESP_WIFI_AMPDU_TX_ENABLED=n
CONFIG_ESP_WIFI_AMPDU_RX_ENABLED=n
CONFIG_ESP_WIFI_STA_DISCONNECTED_PM_ENABLE=n
CONFIG_FREERTOS_HZ=1000
CONFIG_ESP_MAIN_TASK_STACK_SIZE=8192
CONFIG_ESPTOOLPY_FLASHSIZE_4MB=y
CONFIG_PARTITION_TABLE_SINGLE_APP_LARGE=y
CONFIG_COMPILER_OPTIMIZATION_SIZE=y
CONFIG_LOG_VERSION_2=y
CONFIG_ESPECTRE_DETECTION_ALGORITHM_LIGHTWEIGHT=y
```

## src/cpp/frontend/Kconfig.projbuild
```kconfig
menu "ESPectre Firmware"

config ESPECTRE_TINYUSB_PRIMARY_CONSOLE
    bool "Use TinyUSB CDC as the primary console"
    depends on IDF_TARGET_ESP32S2
    default n
    help
        Install a TinyUSB CDC ACM device and redirect stdin, stdout, and
        stderr to it. Enable this on ESP32-S2 USB-OTG boards whose ROM USB
        CDC console is not a reliable bidirectional application transport.
        Leave it disabled for UART and USB Serial/JTAG consoles.

config ESPECTRE_EMULATOR_CSI_REPLAY
    bool "Replay recorded CSI inside esp-emu"
    depends on IDF_TARGET_ESP32C3 || IDF_TARGET_ESP32C5 || IDF_TARGET_ESP32C6 || IDF_TARGET_ESP32S3
    default n
    help
        Link wrappers for the ESP-IDF CSI calls so CI can replay recorded CSI
        from UART1 when the firmware runs in esp-emu, which models Wi-Fi but
        not CSI. The replay starts only when the factory MAC in eFuse carries
        the emulator marker, which silicon cannot have. On a real chip the
        wrappers pass every call to ESP-IDF and never touch UART1. ESPHome
        and Native link it; esp-emu does not emulate the other targets.

endmenu
```

## src/cpp/frontend/ble/app/sdkconfig.defaults
```kconfig
# ESPectre BLE firmware defaults

CONFIG_ESPTOOLPY_FLASHSIZE_4MB=y

CONFIG_ESP_WIFI_CSI_ENABLED=y
CONFIG_PM_ENABLE=n
CONFIG_ESP_WIFI_STA_DISCONNECTED_PM_ENABLE=n
CONFIG_ESP_WIFI_AMPDU_TX_ENABLED=n
CONFIG_ESP_WIFI_AMPDU_RX_ENABLED=n
CONFIG_ESP_WIFI_DYNAMIC_RX_BUFFER_NUM=128

CONFIG_PARTITION_TABLE_CUSTOM=y
CONFIG_PARTITION_TABLE_CUSTOM_FILENAME="partitions.csv"

CONFIG_BT_ENABLED=y
CONFIG_BT_NIMBLE_ENABLED=y
CONFIG_BT_NIMBLE_ROLE_PERIPHERAL=y
CONFIG_BT_NIMBLE_ROLE_CENTRAL=n
CONFIG_BT_NIMBLE_SVC_GAP_DEVICE_NAME="ESPectre BLE"
```

## src/cpp/frontend/ble/espectre/Kconfig.projbuild
```kconfig
menu "ESPectre BLE Frontend"

    config ESPECTRE_WIFI_SSID
        string "Wi-Fi SSID"
        default ""

    config ESPECTRE_WIFI_PASSWORD
        string "Wi-Fi password"
        default ""

    config ESPECTRE_WIFI_BSSID
        string "Optional Wi-Fi BSSID lock (aa:bb:cc:dd:ee:ff)"
        default ""

    config ESPECTRE_WIFI_CHANNEL
        int "Optional Wi-Fi channel lock (0 = auto)"
        range 0 14
        default 0

endmenu
```

## src/cpp/frontend/esphome/components/espectre/Kconfig.projbuild
```kconfig
source "${ESPECTRE_SDK_ROOT}/Kconfig.projbuild"
rsource "../../../Kconfig.projbuild"
```

## src/cpp/frontend/matter/app/main/Kconfig.projbuild
```kconfig
rsource "../../../Kconfig.projbuild"

menu "ESPectre Matter"

config ESPECTRE_MATTER_NODE_LABEL
    string "Matter node label"
    default ""
    help
        Optional user-facing label exposed through the Matter Basic Information cluster.

endmenu
```

## src/cpp/frontend/matter/app/sdkconfig.defaults
```kconfig
CONFIG_ESPTOOLPY_FLASHSIZE_4MB=y
CONFIG_COMPILER_OPTIMIZATION_SIZE=y

# Log v2 formats va_list messages without a frontend buffer.
# CONFIG_LOG_VERSION_1 is not set
CONFIG_LOG_VERSION_2=y

CONFIG_PM_ENABLE=n
CONFIG_FREERTOS_HZ=1000

CONFIG_ESP_WIFI_CSI_ENABLED=y
CONFIG_HTTPD_WS_SUPPORT=y
CONFIG_HTTPD_WS_PRE_HANDSHAKE_CB_SUPPORT=y
CONFIG_ESP_WIFI_STA_DISCONNECTED_PM_ENABLE=n
CONFIG_ESP_WIFI_AMPDU_TX_ENABLED=n
CONFIG_ESP_WIFI_AMPDU_RX_ENABLED=n
CONFIG_ESP_WIFI_STATIC_RX_BUFFER_NUM=10
CONFIG_ESP_WIFI_DYNAMIC_TX_BUFFER_NUM=32
CONFIG_ESP_WIFI_DYNAMIC_RX_BUFFER_NUM=32

CONFIG_LWIP_IRAM_OPTIMIZATION=y
CONFIG_LWIP_TCPIP_RECVMBOX_SIZE=32
CONFIG_LWIP_UDP_RECVMBOX_SIZE=16
CONFIG_USE_LWIP_PBUF_RAM_PACKETBUFFER=y
CONFIG_ESP_MATTER_MAX_DYNAMIC_ENDPOINT_COUNT=2
CONFIG_ESP_MATTER_MAX_DEVICE_TYPE_COUNT=2
CONFIG_EVENT_LOGGING_CRIT_BUFFER_SIZE=256
CONFIG_EVENT_LOGGING_INFO_BUFFER_SIZE=256
CONFIG_EVENT_LOGGING_DEBUG_BUFFER_SIZE=256
CONFIG_MAX_EVENT_QUEUE_SIZE=20
CONFIG_ESP_SYSTEM_EVENT_QUEUE_SIZE=16
CONFIG_ESP_SYSTEM_EVENT_TASK_STACK_SIZE=2048
CONFIG_FREERTOS_PLACE_FUNCTIONS_INTO_FLASH=y

CONFIG_PARTITION_TABLE_CUSTOM=y
CONFIG_PARTITION_TABLE_CUSTOM_FILENAME="partitions.csv"

# Dual console for debug: UART0 primary, USB Serial/JTAG secondary.
CONFIG_ESP_CONSOLE_UART_DEFAULT=y
CONFIG_ESP_CONSOLE_SECONDARY_USB_SERIAL_JTAG=y

# Matter over Wi-Fi
CONFIG_ENABLE_WIFI_STATION=y
CONFIG_ENABLE_WIFI_AP=n
CONFIG_ESP_WIFI_SOFTAP_SUPPORT=n

# Matter identity and discovery
# Use ESP-IDF mDNS so Matter and ESPectre publish through one responder.
# CONFIG_USE_MINIMAL_MDNS is not set
CONFIG_DEVICE_VENDOR_ID=0xFFF1
CONFIG_DEVICE_PRODUCT_ID=0x8000
CONFIG_DEVICE_TYPE=0x0107
CONFIG_DEFAULT_DEVICE_HARDWARE_VERSION=1
CONFIG_DEVICE_SOFTWARE_VERSION_NUMBER=300
CONFIG_ENABLE_COMMISSIONABLE_DEVICE_TYPE=y

# ESPectre Matter runtime
CONFIG_ESPECTRE_MATTER_NODE_LABEL=""

# ESPectre sensing runtime
CONFIG_ESPECTRE_DETECTION_ALGORITHM_LIGHTWEIGHT=y
CONFIG_ESPECTRE_WIFI_BAND_2G=y

# Reduce CHIP serial noise in the Matter frontend by compiling out
# progress/detail logs and keeping only CHIP errors.
# CONFIG_CHIP_LOG_DEFAULT_LEVEL_EQUALS_LOG_DEFAULT_LEVEL is not set
CONFIG_CHIP_LOG_DEFAULT_LEVEL_ERROR=y

# Matter commissioning (BLE)
CONFIG_CUSTOM_COMMISSIONABLE_DATA_PROVIDER=y
# CONFIG_ENABLE_TEST_SETUP_PARAMS is not set
CONFIG_BT_ENABLED=y
CONFIG_BT_NIMBLE_ENABLED=y
CONFIG_BT_NIMBLE_ENABLE_CONN_REATTEMPT=n
# Constrain the commissionee-only BLE surface and release it before CASE.
CONFIG_NIMBLE_MAX_CONNECTIONS=1
CONFIG_BT_NIMBLE_MAX_CONNECTIONS=1
CONFIG_BT_NIMBLE_ROLE_CENTRAL=n
CONFIG_BT_NIMBLE_ROLE_OBSERVER=n
CONFIG_USE_BLE_ONLY_FOR_COMMISSIONING=y
CONFIG_BLE_DEVICE_NAME_PREFIX="ESPectre-"

# Matter IPv6 networking
CONFIG_LWIP_IPV6_AUTOCONFIG=y
CONFIG_LWIP_HOOK_IP6_ROUTE_DEFAULT=y
CONFIG_LWIP_HOOK_ND6_GET_GW_DEFAULT=y
CONFIG_LWIP_IPV6_NUM_ADDRESSES=6

# Required by Matter crypto (HKDF-SHA256)
CONFIG_MBEDTLS_HKDF_C=y
```

## src/cpp/frontend/native/app/sdkconfig.defaults.esp32
```kconfig
# ESP32-specific product overrides.

CONFIG_ESP_DEFAULT_CPU_FREQ_MHZ_240=y

CONFIG_ESP_CONSOLE_UART_DEFAULT=y
CONFIG_ESP_CONSOLE_SECONDARY_USB_SERIAL_JTAG=n
```

## src/cpp/frontend/native/espectre/Kconfig.projbuild
```kconfig
rsource "../../../runtime/esp_idf/espectre_config/Kconfig.projbuild"

menu "ESPectre Native Frontend"

    config ESPECTRE_DIRECT_DEV_ORIGINS_ENABLED
        bool "Allow loopback development portal origins"
        default n
        help
            Allow HTTP Origins on any port only when the host is exactly
            localhost, 127.0.0.1, or [::1]. Published firmware must leave
            this disabled.

    config ESPECTRE_RECOVERY_BUTTON_ENABLED
        bool "Enable long-press BOOT recovery for Wi-Fi setup"
        default y
        help
            Hold the board BOOT button to clear saved Wi-Fi credentials and
            return to Improv Serial setup. This local recovery path does not
            depend on Wi-Fi, MQTT, or a browser session.

    config ESPECTRE_RECOVERY_BUTTON_GPIO
        int "Wi-Fi recovery button GPIO"
        depends on ESPECTRE_RECOVERY_BUTTON_ENABLED
        default 28 if IDF_TARGET_ESP32C5
        default 9 if IDF_TARGET_ESP32C3 || IDF_TARGET_ESP32C6
        default 0
        range 0 48
        help
            Active-low GPIO connected to the board BOOT button. Defaults to
            the download strap used by Espressif development boards.

    config ESPECTRE_RECOVERY_BUTTON_HOLD_MS
        int "Wi-Fi recovery button hold time (ms)"
        depends on ESPECTRE_RECOVERY_BUTTON_ENABLED
        range 1000 10000
        default 3000

    config ESPECTRE_WIFI_SSID
        string "Wi-Fi SSID"
        default ""

    config ESPECTRE_WIFI_PASSWORD
        string "Wi-Fi password"
        default ""

    config ESPECTRE_WIFI_BSSID
        string "Optional Wi-Fi BSSID lock (aa:bb:cc:dd:ee:ff)"
        default ""

    config ESPECTRE_WIFI_CHANNEL
        int "Optional Wi-Fi channel hint (0 = auto)"
        range 0 177 if SOC_WIFI_SUPPORT_5G
        range 0 14
        default 0
        help
            Starts association on one channel. 0 scans normally. The runtime
            rejects values that are not 20 MHz channel centers or do not match
            the selected Wi-Fi band. Pair with a BSSID for a fixed AP radio.

    config ESPECTRE_MQTT_ENABLED
        bool "Enable MQTT telemetry"
        default n

    config ESPECTRE_DEVICE_LABEL
        string "Device label"
        default ""

    config ESPECTRE_MQTT_HOST
        string "MQTT broker host"
        default ""

    config ESPECTRE_MQTT_SCHEME
        string "MQTT broker scheme"
        default ""
        help
            Use mqtt for an explicitly plaintext connection, or mqtts for a
            TLS connection with broker certificate and hostname verification.

    config ESPECTRE_MQTT_PORT
        int "MQTT broker port"
        range 0 65535
        default 0
        help
            Zero means MQTT is not configured. A configured endpoint requires
            an explicit scheme, host, and port.

    config ESPECTRE_MQTT_USERNAME
        string "MQTT username"
        default ""

    config ESPECTRE_MQTT_PASSWORD
        string "MQTT password"
        default ""

    config ESPECTRE_TOPIC_PREFIX
        string "MQTT topic prefix"
        default "espectre/v1/devices"

    config ESPECTRE_HA_DISCOVERY_ENABLED
        bool "Enable Home Assistant MQTT Discovery adapter"
        default y

    config ESPECTRE_HA_DISCOVERY_PREFIX
        string "Home Assistant MQTT discovery prefix"
        default "homeassistant"

    menu "Advanced task scheduling"

        config ESPECTRE_NATIVE_LOOP_TASK_PRIORITY
            int "Native frontend loop task priority"
            range 1 10
            default 5
            help
                FreeRTOS priority for the Native frontend and sensing loop.
                Lowering it can delay CSI processing; raising it can starve
                Direct, managed traffic, and other lower-priority tasks.

    endmenu

endmenu
```

## src/cpp/frontend/streamer/espectre/Kconfig.projbuild
```kconfig
menu "ESPectre CSI Streamer"

    config ESPECTRE_WIFI_SSID
        string "Wi-Fi SSID"
        default ""

    config ESPECTRE_WIFI_PASSWORD
        string "Wi-Fi password"
        default ""

    config ESPECTRE_WIFI_BSSID
        string "Optional Wi-Fi BSSID lock (aa:bb:cc:dd:ee:ff)"
        default ""

    config ESPECTRE_WIFI_CHANNEL
        int "Optional Wi-Fi channel lock (0 = auto)"
        range 0 14
        default 0

    config ESPECTRE_COLLECTOR_PORT
        int "Collector UDP port"
        range 1 65535
        default 5001

    comment "Shared runtime traffic ingress"

    config ESPECTRE_TRAFFIC_RX_PORT
        int "External traffic listener UDP port"
        range 1 65535
        default 9999

    config ESPECTRE_TRAFFIC_RX_MULTICAST_GROUP
        string "Optional external traffic multicast group"
        default ""

    comment "Streamer-local transport"

    config ESPECTRE_STREAM_LOG_INTERVAL_MS
        int "Telemetry log interval (ms)"
        range 100 10000
        default 1000

endmenu
```
