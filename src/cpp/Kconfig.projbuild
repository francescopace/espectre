## src/cpp/runtime/esp_idf/espectre_config/Kconfig.projbuild
```kconfig
menu "ESPectre Sensing"

choice ESPECTRE_WIFI_BAND_POLICY
    prompt "Wi-Fi band policy"
    default ESPECTRE_WIFI_BAND_2G
    help
        Keep the production CSI PHY at HT20 while choosing which radio band
        may be used. 5 GHz and automatic selection require dual-band silicon.

    config ESPECTRE_WIFI_BAND_2G
        bool "2.4 GHz only"

    config ESPECTRE_WIFI_BAND_5G
        bool "5 GHz only"
        depends on SOC_WIFI_SUPPORT_5G

    config ESPECTRE_WIFI_BAND_AUTO
        bool "Automatic 2.4/5 GHz selection"
        depends on SOC_WIFI_SUPPORT_5G
endchoice

choice ESPECTRE_DETECTION_ALGORITHM
    prompt "Detection profile"
    default ESPECTRE_DETECTION_ALGORITHM_LIGHTWEIGHT
    help
        Select the detector used by the shared ESPectre sensing runtime.

    config ESPECTRE_DETECTION_ALGORITHM_LIGHTWEIGHT
        bool "Lightweight Detection"
        help
            Lower active CPU and working-memory cost, with quiet-room startup
            threshold calibration.

    config ESPECTRE_DETECTION_ALGORITHM_HIGH_ACCURACY
        bool "High-Accuracy Detection"
        help
            Stronger detection quality and generalization, with additional
            feature state and neural-inference work. No threshold calibration.
endchoice

config ESPECTRE_SEGMENTATION_WINDOW_SIZE_MS
    int "Segmentation window duration (milliseconds)"
    range 1000 2000
    default 1000
    help
        Detector window in elapsed time. The runtime combines this duration
        with the configured CSI target to build a fixed temporal slot grid.

config ESPECTRE_CSI_TARGET_PPS
    int "Target CSI sensing cadence (pps)"
    range 1 500
    default 100
    help
        Defines the detector's temporal sampling grid and the target used by
        managed traffic. Select the CSI traffic mode separately; zero is not a
        disable sentinel.

choice ESPECTRE_CSI_TRAFFIC_MODE
    prompt "CSI traffic ownership"
    default ESPECTRE_CSI_TRAFFIC_MODE_INTERNAL
    help
        Select who supplies CSI-bearing traffic. This is independent of the
        positive sensing target configured above.

    config ESPECTRE_CSI_TRAFFIC_MODE_INTERNAL
        bool "Internal generator"

    config ESPECTRE_CSI_TRAFFIC_MODE_EXTERNAL
        bool "External source"

    config ESPECTRE_CSI_TRAFFIC_MODE_PACING
        bool "Externally paced source"
        help
            Same UDP listener as External on sensing firmware. Streamer uses this
            internally. Not offered over MQTT, Home Assistant, or the website.

    config ESPECTRE_CSI_TRAFFIC_MODE_DISABLED
        bool "Unmanaged ambient traffic"
endchoice

config ESPECTRE_CSI_TRAFFIC_MULTICAST_GROUP
    string "External traffic multicast group"
    default "239.255.0.1"
    help
        IPv4 multicast group the UDP listener joins in external and pacing
        modes. Empty disables the join. Unicast to the device IP still works.
        Subnet and limited broadcast do not produce reliable CSI.

choice ESPECTRE_TRAFFIC_GENERATOR_MODE
    prompt "Traffic generator mode"
    default ESPECTRE_TRAFFIC_GENERATOR_MODE_PING

    config ESPECTRE_TRAFFIC_GENERATOR_MODE_DNS
        bool "DNS"

    config ESPECTRE_TRAFFIC_GENERATOR_MODE_PING
        bool "PING"
endchoice

config ESPECTRE_PUBLISH_INTERVAL_MS
    int "Publish interval (milliseconds)"
    range 100 60000
    default 1000

config ESPECTRE_EVALUATION_INTERVAL_MS
    int "Evaluation interval (milliseconds)"
    range 10 10000
    default 250

config ESPECTRE_MOTION_ON_HITS
    int "Motion-on hits"
    range 1 20
    default 4

config ESPECTRE_MOTION_OFF_HITS
    int "Motion-off hits"
    range 1 20
    default 3

config ESPECTRE_LOWPASS_ENABLED
    bool "Enable low-pass filter"
    default n

config ESPECTRE_LOWPASS_CUTOFF
    string "Low-pass cutoff (Hz)"
    default "11.0"
    depends on ESPECTRE_LOWPASS_ENABLED
    help
        Low-pass cutoff frequency as a decimal string in the 5.0-20.0 range.

config ESPECTRE_HAMPEL_ENABLED
    bool "Enable Hampel filter"
    default y

config ESPECTRE_HAMPEL_WINDOW
    int "Hampel window"
    range 3 11
    default 7
    depends on ESPECTRE_HAMPEL_ENABLED

config ESPECTRE_HAMPEL_THRESHOLD
    string "Hampel threshold (MAD)"
    default "5.0"
    depends on ESPECTRE_HAMPEL_ENABLED
    help
        Hampel threshold as a decimal string in the 1.0-10.0 range.

config ESPECTRE_DEBUG_TELEMETRY
    bool "Enable runtime debug telemetry"
    default n
    help
        Enable periodic ESPectre runtime DEBUG telemetry with heap, load, and
        timing metrics. The logs appear when the relevant runtime tags are
        raised to DEBUG, for example during firmware benchmarking. On-demand
        CSI and Wi-Fi diagnostics are available independently of this option.

endmenu
```

## src/frontend/matter/app/sdkconfig.defaults
```kconfig
# ESPectre Matter firmware defaults
# esp_matter is resolved via main/idf_component.yml (ESP Component Registry)

# Dual OTA app slots + SPIFFS require 4 MB flash (see partitions.csv)
CONFIG_ESPTOOLPY_FLASHSIZE_4MB=y

CONFIG_ESP_WIFI_CSI_ENABLED=y
CONFIG_PM_ENABLE=n
CONFIG_ESP_WIFI_STA_DISCONNECTED_PM_ENABLE=n
CONFIG_ESP_WIFI_AMPDU_TX_ENABLED=n
CONFIG_ESP_WIFI_AMPDU_RX_ENABLED=n
CONFIG_ESP_WIFI_DYNAMIC_RX_BUFFER_NUM=128

# SPIFFS calibration buffer
CONFIG_PARTITION_TABLE_CUSTOM=y
CONFIG_PARTITION_TABLE_CUSTOM_FILENAME="partitions.csv"

# Matter over Wi-Fi
CONFIG_ENABLE_WIFI_STATION=y
CONFIG_ENABLE_WIFI_AP=n
CONFIG_ESP_WIFI_SOFTAP_SUPPORT=n

# Matter commissioning (BLE)
CONFIG_BT_ENABLED=y
CONFIG_BT_NIMBLE_ENABLED=y
CONFIG_BT_NIMBLE_ENABLE_CONN_REATTEMPT=n

# Matter IPv6 networking
CONFIG_LWIP_IPV6_AUTOCONFIG=y
CONFIG_LWIP_HOOK_IP6_ROUTE_DEFAULT=y
CONFIG_LWIP_HOOK_ND6_GET_GW_DEFAULT=y
CONFIG_LWIP_IPV6_NUM_ADDRESSES=6

# Required by Matter crypto (HKDF-SHA256)
CONFIG_MBEDTLS_HKDF_C=y
```

## src/frontend/streamer/espectre/Kconfig.projbuild
```kconfig
menu "ESPectre CSI Streamer"

    config ESPECTRE_WIFI_SSID
        string "Wi-Fi SSID"
        default ""

    config ESPECTRE_WIFI_PASSWORD
        string "Wi-Fi password"
        default ""

    config ESPECTRE_WIFI_BSSID
        string "Optional Wi-Fi BSSID lock (aa:bb:cc:dd:ee:ff)"
        default ""

    config ESPECTRE_STREAM_OUTPUT_ENABLED
        bool "Enable UDP stream output"
        default y

    config ESPECTRE_COLLECTOR_IP
        string "Collector IPv4 address"
        default ""

    config ESPECTRE_COLLECTOR_PORT
        int "Collector UDP port"
        range 1 65535
        default 5001

    config ESPECTRE_TRAFFIC_RX_PORT
        int "External traffic listener UDP port"
        range 1 65535
        default 9999

    config ESPECTRE_TRAFFIC_RX_MULTICAST_GROUP
        string "Optional external traffic multicast group"
        default ""

    config ESPECTRE_WIFI_FTM_ENABLED
        bool "Enable automatic Wi-Fi FTM when supported"
        default y

    config ESPECTRE_WIFI_FTM_PERIOD_MS
        int "Wi-Fi FTM periodic interval (ms)"
        range 1000 600000
        default 10000
        depends on ESPECTRE_WIFI_FTM_ENABLED

    config ESPECTRE_WIFI_FTM_RETRY_BACKOFF_MS
        int "Wi-Fi FTM retry backoff (ms)"
        range 1000 3600000
        default 60000
        depends on ESPECTRE_WIFI_FTM_ENABLED

    config ESPECTRE_WIFI_FTM_VERBOSE
        bool "Verbose Wi-Fi FTM logs"
        default n
        depends on ESPECTRE_WIFI_FTM_ENABLED

    config ESPECTRE_GAIN_LOCK_ENABLED
        bool "Enable gain lock before streaming"
        default y

    choice ESPECTRE_GAIN_LOCK_MODE
        prompt "Gain lock mode"
        default ESPECTRE_GAIN_LOCK_MODE_AUTO

        config ESPECTRE_GAIN_LOCK_MODE_AUTO
            bool "AUTO"

        config ESPECTRE_GAIN_LOCK_MODE_ENABLED
            bool "ENABLED"

        config ESPECTRE_GAIN_LOCK_MODE_DISABLED
            bool "DISABLED"
    endchoice

    config ESPECTRE_TRAFFIC_GENERATOR_RATE
        int "Traffic generator rate (pps, 0 = external traffic)"
        range 0 10000
        default 0

    choice ESPECTRE_TRAFFIC_GENERATOR_MODE
        prompt "Traffic generator mode"
        default ESPECTRE_TRAFFIC_GENERATOR_MODE_PING

        config ESPECTRE_TRAFFIC_GENERATOR_MODE_PING
            bool "PING"

        config ESPECTRE_TRAFFIC_GENERATOR_MODE_DNS
            bool "DNS"
    endchoice

    config ESPECTRE_STREAM_QUEUE_SLOTS
        int "Preallocated stream queue slots"
        range 2 32
        default 8

    config ESPECTRE_STREAM_LOG_INTERVAL_MS
        int "Telemetry log interval (ms)"
        range 100 10000
        default 1000

endmenu
```
