## src/python/micro_espectre/firmware/components/espectre_core/Kconfig.projbuild
```kconfig
menu "Micro-ESPectre"

config ESPECTRE_DIRECT_DEV_ORIGINS_ENABLED
    bool "Allow loopback development portal origins"
    default n
    help
        Allow HTTP Origins on any port only when the host is exactly
        localhost, 127.0.0.1, or [::1]. Published firmware must leave
        this disabled.

config ESPECTRE_WIFI_TX_RATE_MBPS
    string "Wi-Fi TX rate (0=auto, 6, or 6.5 Mbps)"
    default "6.5" if IDF_TARGET_ESP32
    default "0"
    help
        Use the shared Wi-Fi TX rate policy after station connection,
        independently of traffic generation. Zero keeps automatic rates.
        6.5 selects HT20 MCS0 with long GI; 6 selects legacy OFDM.
        Fixed rates require TX A-MPDU disabled and AP support for the PHY.
        Values other than 0, 6, and 6.5 fail firmware compilation.

menu "Advanced task scheduling"

config ESPECTRE_DIRECT_HTTPD_TASK_PRIORITY
    int "Direct HTTPD task priority"
    range 1 10
    default 1
    help
        FreeRTOS priority for the native Direct HTTP server task. Raising it
        can reduce HTTP latency but can starve the MicroPython VM that drains
        CSI records, especially on single-core targets.

config ESPECTRE_TRAFFIC_TASK_PRIORITY
    int "Managed traffic generator task priority"
    range 1 10
    default 1
    help
        FreeRTOS priority for the native managed traffic task. This work is
        best effort; raising it can starve the MicroPython VM while Wi-Fi and
        lwIP drain bursts.

endmenu

endmenu
```
