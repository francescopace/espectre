## main/Kconfig.projbuild
```kconfig
menu "ESPectre Configuration"

    config WIFI_SSID
        string "WiFi SSID"
        default "your_wifi_ssid"
        help
            SSID (network name) for the device to connect to.

    config WIFI_PASSWORD
        string "WiFi Password"
        default "your_wifi_password"
        help
            WiFi password (WPA or WPA2) for the device to use.

    config WIFI_COUNTRY_CODE
        string "WiFi Country Code"
        default "IT"
        help
            Two-letter ISO country code (e.g., IT, US, GB, DE, FR).
            This sets the regulatory domain for Wi-Fi channels.
            Common codes: IT (Italy), US (United States), GB (United Kingdom),
            DE (Germany), FR (France), ES (Spain), JP (Japan), CN (China).

    config MQTT_BROKER_URI
        string "MQTT Broker URI"
        default "mqtt://homeassistant.local:1883"
        help
            URI of the MQTT broker to connect to.
            Format: mqtt://hostname:port or mqtts://hostname:port for SSL

    config MQTT_TOPIC
        string "MQTT Topic"
        default "home/espectre/node1"
        help
            MQTT topic to publish detection data to.

    config MQTT_USERNAME
        string "MQTT Username"
        default ""
        help
            Username for MQTT broker authentication (leave empty if not required).

    config MQTT_PASSWORD
        string "MQTT Password"
        default ""
        help
            Password for MQTT broker authentication (leave empty if not required).

endmenu
```

## test_app/sdkconfig.defaults
```kconfig
# ESP32 Configuration for Unit Tests (ESP32-S3)
CONFIG_IDF_TARGET="esp32c6"

# Unity test framework
CONFIG_UNITY_ENABLE_FLOAT=y
CONFIG_UNITY_ENABLE_DOUBLE=y
CONFIG_UNITY_ENABLE_IPC_ISR=y

# Increase main task stack size for tests
CONFIG_ESP_MAIN_TASK_STACK_SIZE=8192

# Enable console for test output
CONFIG_ESP_CONSOLE_UART_DEFAULT=y
CONFIG_ESP_CONSOLE_UART_NUM=0
CONFIG_ESP_CONSOLE_UART_BAUDRATE=115200

# Disable WiFi for unit tests (tests don't need actual WiFi)
# CONFIG_ESP_WIFI_ENABLED is not set

# Disable task watchdog for interactive test menu
CONFIG_ESP_TASK_WDT_EN=n

# Custom partition table with larger app partition (2MB)
CONFIG_PARTITION_TABLE_CUSTOM=y
CONFIG_PARTITION_TABLE_CUSTOM_FILENAME="partitions.csv"
CONFIG_PARTITION_TABLE_FILENAME="partitions.csv"

# Flash size configuration (4MB to accommodate 2MB app + other partitions)
CONFIG_ESPTOOLPY_FLASHSIZE_4MB=y
CONFIG_ESPTOOLPY_FLASHSIZE="4MB"

# Line ending configuration
CONFIG_LIBC_STDIN_LINE_ENDING_CR=y
CONFIG_LIBC_STDOUT_LINE_ENDING_CRLF=y
```
